## boards/mediatek/mt8365_genio_350_evk/Kconfig.mt8365_genio_350_evk
```kconfig
# Copyright 2025 Mediatek
# SPDX-License-Identifier: Apache-2.0

config BOARD_MT8365_GENIO_350_EVK
	select SOC_MT8365_ADSP if BOARD_MT8365_GENIO_350_EVK_MT8365_ADSP
```

## boards/mediatek/mt8365_genio_350_evk/board.yml
```yaml
board:
  name: mt8365_genio_350_evk
  full_name: Genio 350 EVK
  vendor: mediatek
  socs:
    - name: mt8365
```

## boards/mediatek/mt8395_genio_1200_evk/Kconfig.mt8395_genio_1200_evk
```kconfig
# Copyright (c) 2026 MediaTek Inc.
# SPDX-License-Identifier: Apache-2.0

config BOARD_MT8395_GENIO_1200_EVK
	select SOC_MT8195_ADSP if BOARD_MT8395_GENIO_1200_EVK_MT8195_ADSP
```

## boards/mediatek/mt8395_genio_1200_evk/board.yml
```yaml
boards:
  - name: mt8395_genio_1200_evk
    full_name: Genio 1200 EVK
    vendor: mediatek
    socs:
      - name: mt8195
```

## dts/bindings/dma/mediatek,afe-memif-dma.yaml
```yaml
# Copyright 2026 MediaTek
# SPDX-License-Identifier: Apache-2.0

description: |
  MediaTek AFE MEMIF DMA controller.

  The Audio Front End (AFE) moves samples between DSP memory and the
  audio interfaces using a set of MEMIF ("memory interface") engines.
  Each DMA channel of this controller corresponds one-to-one to a
  hardware MEMIF, in the same order as the "mediatek,afe" nodes are
  declared, so dma-channels must match the number of those nodes.

  The per-MEMIF register layout is not described here; it is carried by
  the individual "mediatek,afe" nodes.  The reg property below is the
  base of the AFE register block, used to resolve the offsets those
  nodes are converted into.

compatible: "mediatek,afe-memif-dma"

include: [base.yaml, dma-controller.yaml]

properties:
  reg:
    required: true

  dma-channels:
    required: true
```

## dts/bindings/dma/mediatek,sof-host-dma.yaml
```yaml
# Copyright 2026 MediaTek
# SPDX-License-Identifier: Apache-2.0

description: |
  MediaTek SOF host DMA.

  Not a hardware DMA controller.  The MediaTek ADSP can access host
  memory directly, so this "controller" is implemented in software as
  memcpy plus cache maintenance.  It exists so that the SOF host
  component can use the regular Zephyr DMA API.

compatible: "mediatek,sof-host-dma"

include: [base.yaml, dma-controller.yaml]

properties:
  dma-channels:
    required: true
```
